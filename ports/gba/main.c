// Copyright 2026 Luginfo10
//
// Licensed under the Apache License, Version 2.0 (the "License");
// you may not use this file except in compliance with the License.
// You may obtain a copy of the License at
//
//     http://www.apache.org/licenses/LICENSE-2.0
//
// Unless required by applicable law or agreed to in writing, software
// distributed under the License is distributed on an "AS IS" BASIS,
// WITHOUT WARRANTIES OR CONDITIONS OF ANY KIND, either express or implied.
// See the License for the specific language governing permissions and
// limitations under the License.

// PROTOTYPE, modeled on ports/pico-ice/main.c. The LUGFORTH_SIM half is a normal
// POSIX program and has been run and tested extensively. The real (non-SIM)
// half boots correctly too, confirmed both under mgba and by the user on
// their own machine (tiles drawn on screen, matching the simulator): it
// needed crt0.s to copy .data from ROM to EWRAM (see the comment there),
// which it did not before -- see ../README.md.

#include <stdio.h>

#ifdef LUGFORTH_SIM
# include <time.h>
# include <unistd.h>
#endif

#include "common/tier0_opcodes.h"
#include "common/tier1_opcodes.h"
#include "common/tier2_opcodes.h"
#include "common/floats.h"
#include "common/calls.h"

// Plain RGB15 pixels, no palette, generated by convert_tiles.py from
// examples/games/sdl2_tiles.png; see platform.fs's draw-tile. Available under
// LUGFORTH_SIM too, so tile-drawing Forth code can be developed there.
#include "ports/gba/tiles_data.h"
static void *gba_tiles(void) { return (void *) gba_tiles_data; }

// The GBA has 256K of slower EWRAM plus 32K of fast IWRAM; this heap lives
// in EWRAM (see gba.ld) and is deliberately the same size already proven
// working on pico-ice's RP2040 (which also has no PSRAM and a comparable
// total). STACK_CELLS likewise matches pico-ice.
#ifndef LUGFORTH_SIM
# define HEAP_SIZE (150 * 1024)
#else
# define HEAP_SIZE (300 * 1024)
#endif
#define STACK_CELLS (4 * 1024)

// ---- minimal GBA hardware access: no libgba/devkitARM, just the fixed
// memory-mapped register addresses every GBA reference documents. Exposed
// to Forth as addresses returned by opcodes (gba_reg_*, gba_vram), not as
// hardcoded literals in platform.fs, so LUGFORTH_SIM can point them at
// ordinary heap memory instead of real (unmapped, segfaulting-on-POSIX)
// hardware addresses: this is what lets the exact same Forth graphics code
// be developed and unit-tested in the simulator. ----
#ifndef LUGFORTH_SIM

#define REG_DISPCNT  (*(volatile unsigned short *) 0x04000000)
#define REG_VCOUNT   (*(volatile unsigned short *) 0x04000006)
#define REG_KEYINPUT (*(volatile unsigned short *) 0x04000130)

static void *gba_reg_dispcnt(void)  { return (void *) 0x04000000; }
static void *gba_reg_vcount(void)   { return (void *) 0x04000006; }
static void *gba_reg_keyinput(void) { return (void *) 0x04000130; }
static void *gba_vram(void)         { return (void *) 0x06000000; }

// mGBA's emulator-only debug console (https://mgba.io, "Debugging" ->
// "Using the debugger console" documents the same addresses): write a
// NUL-terminated string to 0x4FFF600, then a level (0-4) with 0x100 set to
// 0x4FFF700 to flush it. Harmless no-op on real hardware and on other
// emulators, since that memory is simply unmapped there.
#define REG_DEBUG_ENABLE (*(volatile unsigned short *) 0x4FFF780)
#define REG_DEBUG_FLAGS  (*(volatile unsigned short *) 0x4FFF700)
#define REG_DEBUG_STRING ((volatile char *) 0x4FFF600)

static unsigned gba_frame_count = 0;

static void gba_vblank_wait(void) {
  while (REG_VCOUNT < 160) {}
  while (REG_VCOUNT >= 160) {}
  gba_frame_count++;   // see REQUIRED_SYSTEM_SUPPORT in builtins.h: time only
                        // advances when Forth yields (`pause`), no timer
                        // interrupt is set up in this first prototype.
}

static unsigned gba_ms_ticks(void) {
  return gba_frame_count * 1000u / 60u;
}

static void gba_halt_forever(void) {
  for (;;) { __asm__ volatile("swi 0x02" ::: "memory"); }  // BIOS Halt
}

static void gba_mgba_print(const unsigned char *s, unsigned n) {
  if (n > 255) n = 255;
  for (unsigned i = 0; i < n; i++) REG_DEBUG_STRING[i] = s[i];
  REG_DEBUG_STRING[n] = 0;
  REG_DEBUG_FLAGS = 0x102;  // level 2 ("warning"): visible by default in mGBA's log
}

// A bump allocator for ALLOCATE/FREE/RESIZE (see builtins.h): no libc
// malloc, so no newlib heap/_sbrk to wire up for a first bare-metal boot.
// FREE is a no-op and RESIZE always grows a new block: fine for a prototype
// that never calls any of the three yet, wrong for one that frees a lot.
#define BUMP_HEAP_SIZE (16 * 1024)
static unsigned char bump_heap[BUMP_HEAP_SIZE];
static unsigned char *bump_next = bump_heap;
static void *gba_malloc(unsigned n) {
  if (bump_next + n > bump_heap + BUMP_HEAP_SIZE) return 0;
  void *p = bump_next;
  bump_next += n;
  return p;
}
static void gba_free(void *p) { (void) p; }
static void *gba_realloc(void *p, unsigned n) { (void) p; return gba_malloc(n); }

#else  // LUGFORTH_SIM: ordinary heap memory standing in for real registers/VRAM

static unsigned short sim_dispcnt, sim_vcount, sim_keyinput = 0xffff;
static unsigned char sim_vram[240 * 160 * 2];
static void *gba_reg_dispcnt(void)  { return &sim_dispcnt; }
static void *gba_reg_vcount(void)   { return &sim_vcount; }
static void *gba_reg_keyinput(void) { return &sim_keyinput; }  // stays "nothing pressed"
static void *gba_vram(void)         { return sim_vram; }

#endif  // !LUGFORTH_SIM

// A native tile blit and rect fill, called from platform.fs's
// draw-tile-tinted/gba-fill-rect: a per-pixel Forth loop (the original
// draw-tile-tinted, still in platform.fs's history) works, but each pixel
// costs a handful of interpreted word dispatches, and a full-screen redraw
// is 30000+ pixels -- confirmed by the user on real mgba: about 20 seconds
// per redraw, unplayable. Compiled C does the same math directly, no
// interpreter dispatch per pixel; portable (just array writes through
// gba_vram()/gba_tiles(), real addresses or the sim's stand-in arrays
// either way), so one implementation serves both builds. RGB15 channel
// layout (r bits0-4, g bits5-9, b bits10-14) has to match rgb15/tint in
// platform.fs exactly, see the comment there.
static void gba_blit_tile(int tile, int sx, int sy, unsigned tint) {
  unsigned short *vram = (unsigned short *) gba_vram();
  const unsigned short *src = (const unsigned short *) gba_tiles() + tile * 64;
  int tr = (tint >> 10) & 0x1f, tg = (tint >> 5) & 0x1f, tb = tint & 0x1f;
  int identity = (tr == 0x1f && tg == 0x1f && tb == 0x1f);
  int px, py;
  for (py = 0; py < 8; py++) {
    int y = sy + py;
    if (y < 0 || y >= 160) { src += 8; continue; }
    unsigned short *row = vram + y * 240;
    for (px = 0; px < 8; px++) {
      unsigned short c = *src++;
      int x = sx + px;
      if (c == 0xffff || x < 0 || x >= 240) continue;  // transparent / off-screen
      if (!identity) {
        int r = c & 0x1f, g = (c >> 5) & 0x1f, b = (c >> 10) & 0x1f;
        r = r * tr / 0x1f; g = g * tg / 0x1f; b = b * tb / 0x1f;
        c = r | (g << 5) | (b << 10);
      }
      row[x] = c;
    }
  }
}

static void gba_fill_rect(int x, int y, int w, int h, unsigned color) {
  unsigned short *vram = (unsigned short *) gba_vram();
  int i, j;
  for (j = 0; j < h; j++) {
    int yy = y + j;
    if (yy < 0 || yy >= 160) continue;
    unsigned short *row = vram + yy * 240;
    for (i = 0; i < w; i++) {
      int xx = x + i;
      if (xx >= 0 && xx < 240) row[xx] = (unsigned short) color;
    }
  }
}


// ---- Magnoquill (ports/gba/magnoquill.fs): the whole point cloud in 16.16
// fixed point. The ARM7TDMI has no FPU, and the same formulas as Forth floats
// (software sin/cos) took more than ten seconds for 250 points; with a sine
// table and 64-bit integer products one point costs under a thousand cycles.
// Same formulas as examples/graphics/sdl2_magnoquill.fs, scaled 0.4 into
// 240x160 (the 800x800 picture is 160x160 here, centered), each point erases
// the pixel it drew in the previous frame (mode 3 is a single buffer).
#include "ports/gba/magno_sin.h"
#define MAGNO_MAX 1500
typedef long long q64;
static unsigned short *magno_old[MAGNO_MAX];
static int magno_old_n;
static inline q64 q_mul(q64 a, q64 b) { return (a * b) >> 16; }
static inline q64 q_sin(q64 a) {   // a in radians, 16.16
  return magno_sin_table[(int) ((a * 10680626ll) >> 32) & 1023];
}
static inline q64 q_cos(q64 a) { return q_sin(a + 102944); }   // + pi/2
static inline q64 q_abs(q64 a) { return a < 0 ? -a : a; }
// a / n without a division: the ARM7TDMI has none, and a 64-bit division is a
// library call of about a thousand cycles (the first version spent 24000
// cycles a point, most of it in those). k = 2^32 / n.
#define Q_DIV(a, k) ((int) (((a) * (q64) (k)) >> 32))
#define Q_DIV_64(a, k) (((a) * (q64) (k)) >> 32)
#define K11 390451572ll
#define K14 306783378ll
#define K235 18276456ll
#define K9 477218588ll
#define K17 252645135ll
#define K49 87652393ll
#define K1000 4294967ll
#define K10000 429497ll
#define K100 42949673ll
#define K10 429496730ll
#define K60 71582788ll
#define IWRAM_CODE __attribute__((section(".iwram_code"), noinline))
IWRAM_CODE static unsigned q_isqrt(unsigned long long v) {   // floor(sqrt(v))
  unsigned long long r = 0, bit = 1ull << 62;
  while (bit > v) bit >>= 2;
  while (bit) {
    if (v >= r + bit) { v -= r + bit; r = (r >> 1) + bit; }
    else r >>= 1;
    bit >>= 2;
  }
  return (unsigned) r;
}
static inline int q_chan(q64 v, q64 bright) {   // v and bright 0..1 -> 0..31
  int n = (int) ((q_mul(v, bright) * 31) >> 16);
  return n < 0 ? 0 : n > 31 ? 31 : n;
}

IWRAM_CODE static void gba_magno(int t, int npts, int colormode) {
  unsigned short *vram = (unsigned short *) gba_vram();
  int i;
  if (npts > MAGNO_MAX) npts = MAGNO_MAX;
  if (npts < 1) npts = 1;
  for (i = npts; i < magno_old_n; i++)             // fewer points than last frame
    if (magno_old[i]) { *magno_old[i] = 0; magno_old[i] = 0; }
  magno_old_n = npts;
  q64 qt = t;
  q64 xstep = (10000ll << 16) / npts;
  q64 ct20 = ((qt >> 1) * 20) % (360ll << 16);
  for (i = 0; i < npts; i++) {
    if (magno_old[i]) { *magno_old[i] = 0; magno_old[i] = 0; }
    q64 x = (10000ll << 16) - i * xstep;
    q64 y = Q_DIV_64(x, K235);
    q64 k = q_mul((4 << 16) + q_sin(Q_DIV_64(x, K11) + qt * 8), q_cos(Q_DIV_64(x, K14)));
    q64 e = (y >> 3) - (19 << 16);
    q64 kk = q_mul(k, k) + q_mul(e, e);
    q64 d = (q64) q_isqrt((unsigned long long) kk << 16) + q_sin(Q_DIV_64(y, K9) + qt * 2);
    q64 a = q_mul(2 * q_sin(y - 3 * d) + (9 << 16), k);
    q64 q = q_mul(q_mul(a, q_sin(Q_DIV_64(y, K17))), 1 << 16) + 2 * q_sin(2 * k);
    q64 c = Q_DIV_64(q_mul(d, d), K49) - qt;
    q64 px = q + 50 * q_cos(c) + (200 << 16);
    q64 py = q_mul(q, q_sin(c)) + 39 * d - (440 << 16);
    q64 bright = q_abs(q_sin(qt * 2 + Q_DIV_64(x, K1000))) + 32768;
    int sx = (int) ((px * 26214) >> 32) + 40;         // px * 0.4 + 40
    int sy = (int) ((((400ll << 16) - py) * 26214) >> 32);
    if (sx < 0 || sx >= 240 || sy < 0 || sy >= 160) continue;
    int r = 31, g = 31, b = 31;
    if (colormode) {
      q64 ct = qt >> 1;
      q64 ph1 = (q_sin(Q_DIV_64(x, K10000) + ct) >> 1) + 32768;
      q64 ph2 = (q_sin(Q_DIV_64(y, K100) + Q_DIV_64(ct * 13, K10)) >> 1) + 32768;
      q64 ph3 = (q_sin(Q_DIV_64(d, K10) + Q_DIV_64(ct * 7, K10)) >> 1) + 32768;
      q64 hue = ph1 * 360 + ct20;
      if (hue >= (360ll << 16)) hue -= 360ll << 16;
      q64 sat = q_mul(ph2, 26214) + 39322;             // 0.6 .. 1
      q64 val = q_mul(ph3, 13107) + 52429;             // 0.8 .. 1
      q64 cc = q_mul(val, sat);
      q64 hp = Q_DIV_64(hue, K60);                               // 0 .. 6
      q64 hm = q_abs((hp & 0x1ffff) - (1 << 16));
      q64 xc = q_mul(cc, (1 << 16) - hm);
      q64 m = val - cc;
      q64 rr, gg, bb;
      switch ((int) (hp >> 16)) {
        case 0: rr = cc; gg = xc; bb = 0; break;
        case 1: rr = xc; gg = cc; bb = 0; break;
        case 2: rr = 0; gg = cc; bb = xc; break;
        case 3: rr = 0; gg = xc; bb = cc; break;
        case 4: rr = xc; gg = 0; bb = cc; break;
        default: rr = cc; gg = 0; bb = xc; break;
      }
      r = q_chan(rr + m, bright); g = q_chan(gg + m, bright); b = q_chan(bb + m, bright);
    } else {
      r = g = b = q_chan(1 << 16, bright);
    }
    unsigned short *p = vram + sy * 240 + sx;
    *p = (unsigned short) (r | (g << 5) | (b << 10));
    magno_old[i] = p;
  }
}

#include "ports/gba/builtins.h"

// TODO: real fault handling (data abort, etc.); not attempted yet.
#define FAULT_ENTRY
static void forth_faults_setup(void) {
}

#include "common/bits.h"
#include "common/core.h"
#include "common/calling.h"
#include "common/interp.h"
#include "gen/gba_boot.h"

#ifndef LUGFORTH_SIM
// A static array instead of malloc(): no newlib heap/_sbrk to wire up for a
// first bare-metal boot. Lives in EWRAM (see gba.ld); 150K is most of its
// 256K, leaving room for the C/Forth stacks and the .bss frame buffers.
static unsigned char heap_mem[HEAP_SIZE];
#endif

int main(int argc, char *argv[]) {
#ifndef LUGFORTH_SIM
  REG_DEBUG_ENABLE = 0xc0de;
  void *heap = heap_mem;
#else
  void *heap = malloc(HEAP_SIZE);
#endif
  forth_init(argc, argv, heap, HEAP_SIZE, boot, sizeof(boot));
  for (;;) { g_sys->rp = forth_run(g_sys->rp); }
  return 0;
}
